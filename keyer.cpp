/*
  This source file is under General Public License version 3.

  Detailed comments are available in the ubitx.h file
*/

#include "ubitx.h"

/*
  CW Keyer
  - - -
  CW Key logic change with Ron's code (ubitx_keyer.cpp)
  Ron's logic has been modified to work with the original uBITX by KD8CEC

  Original Comment
  ----------------
    The CW keyer handles either a straight key or an iambic / paddle key.
    They all use just one analog input line. This is how it works:
    The analog line has the internal pull-up resistor enabled.
    When a straight key is connected, it shorts the pull-up resistor, analog input is 0 volts
    When a paddle is connected, the dot and the dash are connected to the analog pin through
    10K and 2.2K resistors. These produce a 4v and a 2v input to the analog pins.
    So, the readings are as follows:
    0 v - straight key
    1 to 2.5 v - paddle dot
    2.5 to 4.5 v - paddle dash
    2.0 to 0.5 v - dot and dash pressed

    The keyer is written to transparently handle all these cases

    Generating CW
    ---
    The CW is cleanly generated by unbalancing the front-end mixer
    and putting the local oscillator directly at the CW transmit frequency.
    The sidetone, generated by the Arduino is injected into the volume control
*/

/* file-level constants */

/* key state types */
enum {
  KEYSTATE_IDLE,
  KEYSTATE_CHK_DIT,
  KEYSTATE_CHK_DAH,
  KEYSTATE_KEYED_PREP,
  KEYSTATE_KEYED,
  KEYSTATE_INTER_ELEMENT
};

/* variables for Ron's new logic */
static constexpr uint8_t M_DIT_L = 0x01;  // DIT latch
static constexpr uint8_t M_DAH_L = 0x02;  // DAH latch
static constexpr uint8_t M_DIT_PROC = 0x04;  // DIT is being processed

/* CW ADC Range */
static constexpr uint8_t M_CW_ADC_ST_FROM = 0;
static constexpr uint8_t M_CW_ADC_ST_TO = 50;
static constexpr uint8_t M_CW_ADC_BOTH_FROM = 51;
static constexpr uint16_t M_CW_ADC_BOTH_TO = 300;
static constexpr uint16_t M_CW_ADC_DOT_FROM = 301;
static constexpr uint16_t M_CW_ADC_DOT_TO = 600;
static constexpr uint16_t M_CW_ADC_DASH_FROM = 601;
static constexpr uint16_t M_CW_ADC_DASH_TO = 800;

static constexpr uint8_t M_DELAY_BEFORE_CW_START_TIME = 50;

/* file-level variables */
static uint32_t m_kTimer;
static uint8_t m_keyerState = KEYSTATE_IDLE;

/*
  starts transmitting the carrier with the sidetone
  it assumes that we have called cwTxStart and not called cwTxStop
  each time it is called, the cwTimeOut is pushed further into the future
*/
void cwKeyDown ()
{
  tone(PIN_CW_TONE, (int16_t)g_sideTone);
  digitalWrite(CW_KEY, 1);

  // modified by KD8CEC, for CW Delay Time save to eeprom
  g_cwTimeout = millis() + g_cwDelayTime * 10;
}

/*
  stops the cw carrier transmission along with the sidetone
  pushes the cwTimeout further into the future
*/
void cwKeyUp ()
{
  noTone(PIN_CW_TONE);
  digitalWrite(CW_KEY, 0);

  // modified by KD8CEC, for CW Delay Time save to eeprom
  g_cwTimeout = millis() + g_cwDelayTime * 10;
}

/*
  test to reduce the keying error. do not delete lines
  created by KD8CEC for compatible with new CW Logic
*/
uint8_t updatePaddleLatch (bool isUpdateKeyState)
{
  uint8_t tmpKeyerControl = 0;  // was unsigned char

  uint16_t paddle = analogRead(ANALOG_KEYER);  // <<<--- changed from int because docs
                                               //        say analogRead() returns 0 to 1024
                                               //        *by default* for Arduino Nano
  // use the PTT as the key for tune up, quick QSOs
  if (digitalRead(PTT) == 0)
    tmpKeyerControl |= M_DIT_L;
  else if (paddle >= M_CW_ADC_DASH_FROM && paddle <= M_CW_ADC_DASH_TO)
    tmpKeyerControl |= M_DAH_L;
  else if (paddle >= M_CW_ADC_DOT_FROM && paddle <= M_CW_ADC_DOT_TO)
    tmpKeyerControl |= M_DIT_L;
  else if (paddle >= M_CW_ADC_BOTH_FROM && paddle <= M_CW_ADC_BOTH_TO)
    tmpKeyerControl |= (M_DAH_L | M_DIT_L) ;
  else
  {
    if (g_iambicKey)
      tmpKeyerControl = 0 ;
    else if (paddle >= M_CW_ADC_ST_FROM && paddle <= M_CW_ADC_ST_TO)
      tmpKeyerControl = M_DIT_L ;
    else
      tmpKeyerControl = 0 ;
  }

  if (isUpdateKeyState)
    g_keyerControl |= tmpKeyerControl;

  return tmpKeyerControl;
}

/*
  new keyer logic, by RON
  modified by KD8CEC
*/
void cwKeyer ()
{
  if (g_iambicKey)
  {
    bool continueKeyerLoop = true;
    uint8_t tmpKeyControl = 0;

    while (continueKeyerLoop)
    {
      switch (m_keyerState)
      {
        case KEYSTATE_IDLE:
          tmpKeyControl = updatePaddleLatch(false);

          if (tmpKeyControl == M_DAH_L || tmpKeyControl == M_DIT_L ||
              tmpKeyControl == (M_DAH_L | M_DIT_L) || (g_keyerControl & 0x03))
          {
            updatePaddleLatch(true);
            m_keyerState = KEYSTATE_CHK_DIT;
          }
          else
          {
            if (0 < g_cwTimeout && g_cwTimeout < millis())
            {
              g_cwTimeout = 0;
              stopTx();
            }

            continueKeyerLoop = false;
          }
          break;

        case KEYSTATE_CHK_DIT:
          if (g_keyerControl & M_DIT_L)
          {
            g_keyerControl |= M_DIT_PROC;
            m_kTimer = g_cwSpeed;
            m_keyerState = KEYSTATE_KEYED_PREP;
          }
          else
            m_keyerState = KEYSTATE_CHK_DAH;

          break;

        case KEYSTATE_CHK_DAH:
          if (g_keyerControl & M_DAH_L)
          {
            m_kTimer = g_cwSpeed * 3;
            m_keyerState = KEYSTATE_KEYED_PREP;
          }
          else
            m_keyerState = KEYSTATE_IDLE;

          break;

        case KEYSTATE_KEYED_PREP:
          // modified KD8CEC
          if (!g_inTx)
          {
            // DelayTime Option
            activeDelay(M_DELAY_BEFORE_CW_START_TIME * 2);

            // keyDown = 0;
            g_cwTimeout = millis() + g_cwDelayTime * 10;
            startTx(TX_CW);
          }

          m_kTimer += millis();  // set m_kTimer to interval end time
          g_keyerControl &= ~(M_DIT_L + M_DAH_L);  // clear both paddle latch bits
          m_keyerState = KEYSTATE_KEYED;  // next state

          cwKeyDown();
          break;

        case KEYSTATE_KEYED:
          if (millis() > m_kTimer)
          { // are we at end of key down ?
            cwKeyUp();
            m_kTimer = millis() + g_cwSpeed;  // inter-element time
            m_keyerState = KEYSTATE_INTER_ELEMENT;  // next state
          }
          else
          if (g_keyerControl & IAMBICB)
            updatePaddleLatch(true);  // early paddle latch in Iambic B mode

          break;

        case KEYSTATE_INTER_ELEMENT:
          // insert time between dits/dahs
          updatePaddleLatch(true);  // latch paddle state

          if (millis() > m_kTimer)
          { // are we at end of inter-space ?
            if (g_keyerControl & M_DIT_PROC)
            { // was it a dit or dah ?
              g_keyerControl &= ~(M_DIT_L + M_DIT_PROC);  // clear two bits
              m_keyerState = KEYSTATE_CHK_DAH;  // dit done, check for dah
            }
            else
            {
              g_keyerControl &= ~(M_DAH_L);  // clear dah latch
              m_keyerState = KEYSTATE_IDLE;  // go idle
            }
          }
          break;
      }

      checkCAT();
    }  // end of while
  }
  else
  {
    while (true)
    {
      uint8_t state = updatePaddleLatch(false);

      if (state == M_DIT_L)
      {
        // if we are here, it is only because the key is pressed
        if (!g_inTx)
        {
          startTx(TX_CW);

          // delayTime Option
          activeDelay(M_DELAY_BEFORE_CW_START_TIME * 2);

          // keyDown = 0;
          g_cwTimeout = millis() + g_cwDelayTime * 10;
        }

        cwKeyDown();

        while (updatePaddleLatch(false) == M_DIT_L)
          activeDelay(1);

        cwKeyUp();
      }
      else
      {
        if (0 < g_cwTimeout && g_cwTimeout < millis())
        {
          g_cwTimeout = 0;
          stopTx();
        }

        return;  // Tx stop control by Main Loop
      }

      checkCAT();
    }  // end of while
  }   // end of else
}
